#include <Arduino.h>
#include <avr/interrupt.h>
#include <ctype.h>
#include <Print.h>

#include "led_library.h"

#define MARGIN_SIZE = (BITMAP_SIZE - numCols)/2;
const int DEFAULT_SPEED = 75;
static LedScroller *s_inst = NULL;
static int s_marginCount = 0;

const uint8_t charset[][5] PROGMEM = {
                         {0x00, 0x00, 0x00, 0x00, 0x00}, // SPACE
                         {0x00, 0x00, 0x5F, 0x00, 0x00}, // !
                         {0x00, 0x03, 0x00, 0x03, 0x00}, // "
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                         {0x02, 0x01, 0x02, 0x04, 0x02}  // ~
                       };
    
LedScroller::LedScroller(int clk, int dta, int numCols, int *ledPins)
    : _clk(clk), _dta(dta), _currentIndex(0), _currentColumn(0), 
    _currentMargin(BITMAP_SIZE/2), _numCols(numCols), _flipMode(RIGHTSIDE_UP), 
    _scrollMode(false), _scrollSpeed(DEFAULT_SPEED)
{
  static int defaultPins[] = {6,7,8,9,10,11,12,13};
  pinMode(_clk, OUTPUT);
  pinMode(_dta, OUTPUT);
  if (ledPins == NULL) {
    memcpy(_ledPins, defaultPins, sizeof(_ledPins));
  } else {
    memcpy(_ledPins, ledPins, sizeof(_ledPins));
  }
  for (int i=0; i < 8; ++i) {
    pinMode(_ledPins[i], OUTPUT);
    digitalWrite(ledPins[i], LOW);
  }
  
  digitalWrite(_clk, 0);
  digitalWrite(_dta, 0);

  // Set up the timer interrupt
  TCCR2A = 2;  // WGM 2, top=oc2a, clear timer at top
  TCCR2B = 0;
  OCR2A = 750;
  TCNT2 = 0;
  TIFR2 = 7;
  GTCCR |= (1 << PSRASY);
  TIMSK2 |= (1 << OCIE2A);
  TCCR2B = 3;  // clk/32

  clearDisplay();
  
  recalcMinMax();
  s_inst = this;
}

void LedScroller::recalcMinMax()
{
  s_marginCount = 0;
    _dataMin = 0; _dataMax = BITMAP_SIZE-1;
    for (; _dataMin < BITMAP_SIZE; ++_dataMin) if (_bitmap[_dataMin]) break;
    for (; _dataMax >= _dataMin; --_dataMax) if (_bitmap[_dataMax]) break; 
    if (_dataMax <= _dataMin) {
      _scrollMode = false;
    } else {
      if (_dataMin >= _numCols/2) {
        _dataMin -= _numCols/2;
      }
      _currentMargin = _dataMin;
    }
    Serial.print("dataMin "); Serial.print(_dataMin);
    Serial.print("dataMax "); Serial.println(_dataMax);
}

size_t LedScroller::write(uint8_t b)
{
  if (b >= ' ' && b <= '~')
  {
    b -= ' ';
    for (int i=0; _currentIndex < BITMAP_SIZE && i < 5; ++i)
    {
      _bitmap[_currentIndex++] = getByte(b,i);
    }
    if (_currentIndex < BITMAP_SIZE)
    {
      _bitmap[_currentIndex++] = 0;
    }
    return 1;
  }
  return 0;
}

void LedScroller::clearDisplay()
{
  memset(_bitmap, 0, sizeof(_bitmap));
}

uint8_t LedScroller::getByte(char c, uint8_t offset)
{ 
  uint8_t b = pgm_read_byte(&charset[(uint8_t)c][offset]); 
  return flipByte(b);
}

uint8_t LedScroller::flipByte(uint8_t b)
{
  uint8_t ret = 0;
  uint8_t bbb = 64, ccc = 1;
  for (uint8_t i=0; i < 7; ++i)
  {    
    if (b & bbb)
    {
      ret |= ccc;
    }
    bbb >>= 1;
    ccc <<= 1;
  }
  return ret;
}

ISR(TIMER2_COMPA_vect,ISR_NOBLOCK)
{
    s_inst->isr();
}

void LedScroller::isr() {
    int idx = _currentColumn;

    if (_flipMode == UPSIDE_DOWN)
    {
      idx = _numCols - _currentColumn - 5;
    }
    uint8_t b = _bitmap[idx + _currentMargin];
    if (_flipMode == UPSIDE_DOWN)
    {
      b = flipByte(b);
    }
    
    if (_currentColumn == 0)
    {
      digitalWrite(_dta, HIGH);
    }
    else
    {
      digitalWrite(_dta, LOW);
    }
    
    for (int i=0; i < 8; ++i) {
        digitalWrite(_ledPins[i], LOW);
    }

    digitalWrite(_clk, HIGH);
    digitalWrite(_clk, LOW);
    
    for (int i=128, j=0 ; i ; ++j, i >>= 1) {
        digitalWrite(_ledPins[j], (b & i));
    }
    if (++_currentColumn == _numCols)
    {
      _currentColumn = 0;
    }
    
    if (_scrollMode && ++s_marginCount == _scrollSpeed) {
      s_marginCount = 0;
      if (++_currentMargin == _dataMax) {
        _currentMargin = _dataMin;
      }
    }
    
    //digitalWrite(13, LOW);
}
